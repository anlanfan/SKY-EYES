// SkyEye V1 receiver - optimized version.
//
// !!! UNVERIFIED: this sketch has NOT been compiled, uploaded or tested on hardware. !!!
// See ../README.md before use. The original sketch is ../../receiver/receiver.ino.
//
// Hardware and interfaces are unchanged from the original:
//   HC-05 on the hardware Serial port at 9600 baud, receiving the head unit's bytes
//   (even byte = pitch, odd byte = yaw, bytes >= 200 ignored).
//   8-channel PPM on pin D2, 20 ms frame. Each channel = 500 us LOW + N us HIGH.
//   Channels 1-6 are fixed at 1500 us HIGH; channel 7 = pitch, channel 8 = yaw.
//
// On ATmega328P / ATmega168 (classic Arduino Nano / Uno) the PPM signal is generated by
// a Timer1 interrupt. On other boards it falls back to the original blocking method.

// ---------------- Configuration ----------------

const long SERIAL_BAUD = 9600;
const int PPM_PIN = 2;  // must stay D2: the Timer1 path drives PORTD bit 2 directly

const uint8_t NUM_CHANNELS = 8;
const int PPM_FRAME_US = 20000;
const int PPM_SEPARATOR_US = 500;     // LOW pulse before every channel and before sync
const int PPM_FIXED_HIGH_US = 1500;   // channels 1-6 placeholder, as in the original
const int PPM_MAX_HIGH_US = 1500;     // HIGH time at INPUT_ANGLE_MAX
const int PPM_MIN_SEGMENT_US = 20;    // never schedule a timer segment shorter than this
const uint8_t PITCH_CHANNEL = 6;      // 0-based index: channel 7
const uint8_t YAW_CHANNEL = 7;        // 0-based index: channel 8

const int MAX_VALID_BYTE = 200;       // bytes >= 200 are ignored, as in the original
// The original receiver mapped 0..140 to 0..1500 us. The head unit actually sends 0..181,
// so set this to 180 to use the full head range (re-check gimbal travel after changing it).
const int INPUT_ANGLE_MAX = 140;
const int CENTER_ANGLE = 90;          // encoded angle of a head looking straight ahead

// What to output when no data arrives for FAILSAFE_TIMEOUT_MS (also used at power-up).
enum FailsafeMode { FAILSAFE_CENTER, FAILSAFE_HOLD };
const FailsafeMode FAILSAFE_MODE = FAILSAFE_CENTER;
const unsigned long FAILSAFE_TIMEOUT_MS = 500;

// Exponential smoothing of the head channels: 1.0 = off (original behaviour),
// smaller values = smoother but slower response.
const float SMOOTHING_ALPHA = 1.0;
const unsigned long OUTPUT_UPDATE_MS = 20;  // smoothing / failsafe step, once per PPM frame

// Debug output goes through the same Serial port as the HC-05, i.e. back over Bluetooth.
// Keep it off in normal use: printing every loop was what slowed down the original PPM output.
#define DEBUG_PRINT 0
const unsigned long DEBUG_INTERVAL_MS = 200;

#if defined(__AVR_ATmega328P__) || defined(__AVR_ATmega168__)
#define PPM_USE_TIMER1 1
#if F_CPU != 16000000L
#error "Timer1 PPM timing assumes a 16 MHz clock"
#endif
#else
#define PPM_USE_TIMER1 0
#endif

// ---------------- State ----------------

volatile int channelHighUs[NUM_CHANNELS];  // read by the PPM ISR

int lastPitchAngle = CENTER_ANGLE;
int lastYawAngle = CENTER_ANGLE;
bool hasReceived = false;
unsigned long lastReceiveMs = 0;
unsigned long lastOutputUpdateMs = 0;
float smoothedPitchUs = 0;
float smoothedYawUs = 0;

#if DEBUG_PRINT
unsigned long lastDebugMs = 0;
#endif

// ---------------- PPM output ----------------

#if PPM_USE_TIMER1

// Segments per frame: (LOW separator + HIGH value) for each channel, then for sync.
const uint8_t NUM_SEGMENTS = 2 * (NUM_CHANNELS + 1);
volatile uint8_t ppmSegment = 0;
int frameHighUs[NUM_CHANNELS + 1];  // channel values latched at frame start, plus sync (ISR only)

ISR(TIMER1_COMPA_vect) {
  // Set the pin first so edges are not delayed by the work below.
  int segmentUs;
  if (ppmSegment % 2 == 0) {
    PORTD &= ~_BV(PD2);  // D2 LOW
    segmentUs = PPM_SEPARATOR_US;
  } else {
    PORTD |= _BV(PD2);   // D2 HIGH
    segmentUs = frameHighUs[ppmSegment / 2];
  }

  if (ppmSegment == 0) {
    // Latch all channels once per frame so a frame never mixes old and new values.
    // Runs during the first LOW separator, before any channel value is used.
    long usedUs = (long)PPM_SEPARATOR_US * (NUM_CHANNELS + 1);
    for (uint8_t i = 0; i < NUM_CHANNELS; i++) {
      int value = channelHighUs[i];
      frameHighUs[i] = value < PPM_MIN_SEGMENT_US ? PPM_MIN_SEGMENT_US : value;
      usedUs += frameHighUs[i];
    }
    frameHighUs[NUM_CHANNELS] = (int)(PPM_FRAME_US - usedUs);
  }

  if (segmentUs < PPM_MIN_SEGMENT_US) {
    segmentUs = PPM_MIN_SEGMENT_US;
  }
  OCR1A = (uint16_t)(segmentUs * 2 - 1);  // 0.5 us per tick
  ppmSegment = (ppmSegment + 1) % NUM_SEGMENTS;
}

void startPpmOutput() {
  noInterrupts();
  TCCR1A = 0;
  TCCR1B = _BV(WGM12) | _BV(CS11);  // CTC mode, prescaler 8: 0.5 us per tick at 16 MHz
  TCNT1 = 0;
  OCR1A = 2 * PPM_SEPARATOR_US - 1;
  TIMSK1 = _BV(OCIE1A);
  interrupts();
}

#else

// Same waveform as the original ppmsig_post(), with the sync gap computed from the actual values.
void sendPpmFrameBlocking() {
  long usedUs = (long)PPM_SEPARATOR_US * (NUM_CHANNELS + 1);
  for (uint8_t i = 0; i < NUM_CHANNELS; i++) {
    digitalWrite(PPM_PIN, LOW);
    delayMicroseconds(PPM_SEPARATOR_US);
    digitalWrite(PPM_PIN, HIGH);
    delayMicroseconds(channelHighUs[i]);
    usedUs += channelHighUs[i];
  }
  digitalWrite(PPM_PIN, LOW);
  delayMicroseconds(PPM_SEPARATOR_US);
  digitalWrite(PPM_PIN, HIGH);
  delayMicroseconds(PPM_FRAME_US - usedUs);
}

#endif

void setHeadChannels(int pitchUs, int yawUs) {
  noInterrupts();  // int writes are not atomic on AVR
  channelHighUs[PITCH_CHANNEL] = pitchUs;
  channelHighUs[YAW_CHANNEL] = yawUs;
  interrupts();
}

// ---------------- Head tracker input ----------------

int angleToHighUs(int encodedAngle) {
  int angle = constrain(encodedAngle, 0, INPUT_ANGLE_MAX);
  return (int)map(angle, 0, INPUT_ANGLE_MAX, 0, PPM_MAX_HIGH_US);
}

void readHeadTracker() {
  while (Serial.available() > 0) {
    int value = Serial.read();
    if (value < 0 || value >= MAX_VALID_BYTE) {
      continue;
    }
    if (value % 2 == 0) {
      lastPitchAngle = value;
    } else {
      lastYawAngle = value;
    }
    hasReceived = true;
    lastReceiveMs = millis();
  }
}

void updateOutputs() {
  unsigned long now = millis();
  if (now - lastOutputUpdateMs < OUTPUT_UPDATE_MS) {
    return;
  }
  lastOutputUpdateMs = now;

  bool timedOut = !hasReceived || now - lastReceiveMs > FAILSAFE_TIMEOUT_MS;
  if (timedOut && FAILSAFE_MODE == FAILSAFE_CENTER) {
    lastPitchAngle = CENTER_ANGLE;
    lastYawAngle = CENTER_ANGLE;
  }

  smoothedPitchUs += SMOOTHING_ALPHA * (angleToHighUs(lastPitchAngle) - smoothedPitchUs);
  smoothedYawUs += SMOOTHING_ALPHA * (angleToHighUs(lastYawAngle) - smoothedYawUs);
  setHeadChannels((int)(smoothedPitchUs + 0.5f), (int)(smoothedYawUs + 0.5f));

#if DEBUG_PRINT
  if (now - lastDebugMs >= DEBUG_INTERVAL_MS) {
    lastDebugMs = now;
    Serial.print(lastPitchAngle);
    Serial.print(' ');
    Serial.println(lastYawAngle);
  }
#endif
}

// ---------------- Main ----------------

void setup() {
  Serial.begin(SERIAL_BAUD);
  pinMode(PPM_PIN, OUTPUT);

  for (uint8_t i = 0; i < NUM_CHANNELS; i++) {
    channelHighUs[i] = PPM_FIXED_HIGH_US;
  }
  // Start centered instead of at 0 us until the first data arrives.
  smoothedPitchUs = angleToHighUs(CENTER_ANGLE);
  smoothedYawUs = angleToHighUs(CENTER_ANGLE);
  setHeadChannels((int)smoothedPitchUs, (int)smoothedYawUs);

#if PPM_USE_TIMER1
  startPpmOutput();
#endif
}

void loop() {
  readHeadTracker();
  updateOutputs();
#if !PPM_USE_TIMER1
  sendPpmFrameBlocking();
#endif
}
